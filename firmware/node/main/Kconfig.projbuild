## firmware/node/main/Kconfig.projbuild
```kconfig
menu "RoomNode"

    config ROOMNODE_I2C_SDA
        int "I2C SDA GPIO"
        default 21
        help
            SDA pin of the easyC connector. IO21 on the Dasduino ConnectPlus.

    config ROOMNODE_I2C_SCL
        int "I2C SCL GPIO"
        default 22
        help
            SCL pin of the easyC connector. IO22 on the Dasduino ConnectPlus.

    config ROOMNODE_POT_GPIO
        int "Setpoint potentiometer GPIO (ADC1 only)"
        default 34
        help
            Wiper (OUTA) of the slider potentiometer. Must be an ADC1 pin
            (GPIO32-39) because ADC2 is unavailable while Wi-Fi is running.
            Power the potentiometer from 3V3, never from 5 V.

    config ROOMNODE_LED_GPIO
        int "WS2812B stick data GPIO"
        default 27
        help
            DIN of the Smart LED WS2812B Stick10.

    config ROOMNODE_LED_COUNT
        int "Number of LEDs on the stick"
        default 10

    config ROOMNODE_LED_MIRRORED
        bool "LED stick mounted mirrored"
        default y
        help
            Fills the stick from the LED farthest from DIN, so it follows the
            slider when the stick sits the other way round in the enclosure.

    config ROOMNODE_DEMO
        bool "Demo mode"
        default n
        help
            Shortens the minimum on/off time from 5 min to 10 s and regulates on
            a simulated room temperature, so the control loop can be watched
            within minutes. Enabled by sdkconfig.defaults.demo.

    menu "Network"

        config ROOMNODE_ID
            string "Node ID"
            default "node1"
            help
                Used in MQTT topics (roomnode/<id>/...) and the DHCP host name.

        config ROOMNODE_BACNET_INSTANCE
            int "BACnet device instance"
            range 0 4194302
            default 1001
            help
                Must be unique on the BACnet internetwork.

        config ROOMNODE_WIFI_SSID
            string "Wi-Fi SSID (2.4 GHz)"
            default ""
            help
                Leave empty to run without network.

        config ROOMNODE_WIFI_PASSWORD
            string "Wi-Fi password"
            default ""

        config ROOMNODE_MQTT_URI
            string "MQTT broker URI"
            default "mqtt://192.168.1.100:1883"

        config ROOMNODE_MQTT_USERNAME
            string "MQTT username"
            default ""

        config ROOMNODE_MQTT_PASSWORD
            string "MQTT password"
            default ""

    endmenu

endmenu
```
